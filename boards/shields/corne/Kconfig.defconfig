## boards/shields/corne/Kconfig.defconfig
```kconfig
if SHIELD_CORNE_DONGLE

# Max 16 characters in keyboard name
config ZMK_KEYBOARD_NAME
    default "Corne"

# Split Keyboard
config ZMK_SPLIT
    default y
config ZMK_SPLIT_ROLE_CENTRAL
    default y

# Dongle Connection Settings
config ZMK_USB
    default y

endif


if SHIELD_CORNE_LEFT || SHIELD_CORNE_RIGHT

# Split Keyboard
config ZMK_SPLIT
    default y

# Bluetooth Settings
config ZMK_BLE
    default y

# Keyboard Debouncing
config ZMK_KSCAN_DEBOUNCE_PRESS_MS
    default 5
config ZMK_KSCAN_DEBOUNCE_RELEASE_MS
    default 5

endif
```
