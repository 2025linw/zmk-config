## boards/shields/toucan/Kconfig.defconfig
```kconfig
if SHIELD_TOUCAN_DONGLE
    # Max 16 characters in keyboard name
    config ZMK_KEYBOARD_NAME
        default "Toucan"

    config ZMK_SPLIT_ROLE_CENTRAL
        default y

    config ZMK_USB
        default y

    config ZMK_SPLIT
        default y

    config ZMK_SPLIT_BLE_CENTRAL_PERIPHERALS
        default 2

    config BT_MAX_CONN
        default 3

    config BT_MAX_PAIRED
        default 3

    config PROSPECTOR_USE_AMBIENT_LIGHT_SENSOR
        default n
endif


if SHIELD_TOUCAN_LEFT
    config ZMK_SPLIT_BLE_CENTRAL_BATTERY_LEVEL_FETCHING
        default n

    config ZMK_SPLIT_BLE_CENTRAL_BATTERY_LEVEL_PROXY
        default n
endif


if SHIELD_TOUCAN_RIGHT
    config I2C
        default y

    config INPUT_TPS43
        default y
endif


if SHIELD_TOUCAN_DONGLE || SHIELD_TOUCAN_RIGHT
    config ZMK_POINTING
        default y
endif


if SHIELD_TOUCAN_LEFT || SHIELD_TOUCAN_RIGHT
    config ZMK_SPLIT
        default y

    config ZMK_SPLIT_ROLE_CENTRAL
        default n

    config SPI
        default y

    config ZMK_PM_SOFT_OFF
        default y
endif
```

## config/west.yml
```yaml
manifest:
  remotes:
    - name: zmkfirmware
      url-base: https://github.com/zmkfirmware
    - name: m165437 # new nice view
      url-base: https://github.com/M165437
    - name: caksoylar
      url-base: https://github.com/caksoylar
    - name: beekeeb
      url-base: https://github.com/beekeeb
    - name: carrefinho # center dongle
      url-base: https://github.com/carrefinho
  projects:
    - name: zmk
      remote: zmkfirmware
      revision: v0.3.0
      import: app/west.yml
    - name: nice-view-gem
      remote: m165437
      revision: v0.3.0
    - name: zmk-rgbled-widget
      remote: caksoylar
      revision: v0.3
    - name: zmk_driver_azoteq
      remote: beekeeb
      revision: main
    - name: prospector-zmk-module
      remote: carrefinho
      revision: main
  self:
    path: config
```
